#include "bsp_ssd1306.h"
#include "i2c.h"
#include <string.h>
#include <stdlib.h>

static uint8_t ssd1306_i2c_addr = 0x3C << 1;
static uint8_t ssd1306_buffer[SSD1306_WIDTH * SSD1306_HEIGHT / 8];

/* 6x8 Basic ASCII Font Table (ASCII 0x20 ' ' to 0x7E '~') */
static const uint8_t font6x8[][6] = {
  { 0x00, 0x00, 0x00, 0x00, 0x00, 0x00 }, // ' '
  { 0x00, 0x00, 0x5F, 0x00, 0x00, 0x00 }, // '!'
  { 0x00, 0x07, 0x00, 0x07, 0x00, 0x00 }, // '"'
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  { 0x08, 0x08, 0x2A, 0x1C, 0x08, 0x00 }  // '~'
};

bool ssd1306Init(void)
{
  /* I2C 주소 자동 감지: 0x3C (0x78) 우선 시도, 없으면 0x3D (0x7A) */
  if (HAL_I2C_IsDeviceReady(&hi2c1, 0x3C << 1, 2, 10) == HAL_OK)
  {
    ssd1306_i2c_addr = 0x3C << 1;
  }
  else if (HAL_I2C_IsDeviceReady(&hi2c1, 0x3D << 1, 2, 10) == HAL_OK)
  {
    ssd1306_i2c_addr = 0x3D << 1;
  }
  else
  {
    return false;
  }

  HAL_Delay(50);

  /* SSD1306 / SH1106 128x64 범용 표준 초기화 시퀀스 */
  static const uint8_t init_sequence[] = {
    0xAE,             /* Display OFF */
    0xD5, 0x80,       /* Set Display Clock Divide Ratio: 0x80 */
    0xA8, 0x3F,       /* Set Multiplex Ratio: 1/64 duty (0x3F) */
    0xD3, 0x00,       /* Set Display Offset: 0 */
    0x40,             /* Set Start Line: line 0 */
    0x8D, 0x14,       /* Enable Charge Pump (0x14: 7.5V Internal DC-DC) */
    0x20, 0x02,       /* Set Memory Addressing Mode: 0x02 (Page Addressing Mode - SSD1306 & SH1106 공용) */
    0xA1,             /* Set Segment Re-map: column 127 mapped to SEG0 (A1) */
    0xC8,             /* Set COM Output Scan Direction: remapped mode (C8) */
    0xDA, 0x12,       /* Set COM Pins Hardware Config: 0x12 (Alternative COM pin config) */
    0x81, 0xCF,       /* Set Contrast Control: 0xCF */
    0xD9, 0xF1,       /* Set Pre-charge Period: 0xF1 */
    0xDB, 0x40,       /* Set VCOMH Deselect Level: 0x40 */
    0xA4,             /* Entire Display ON: Resume to RAM content */
    0xA6,             /* Set Normal Display (0xA6: 1=White, 0=Black) */
    0xAF              /* Display ON */
  };

  /* 초기화 커맨드 일괄 전송 */
  HAL_StatusTypeDef status = HAL_I2C_Mem_Write(&hi2c1, ssd1306_i2c_addr, 0x00, 1,
                                               (uint8_t *)init_sequence, sizeof(init_sequence), 100);
  if (status != HAL_OK)
  {
    return false;
  }

  HAL_Delay(20);

  /* 화면 버퍼 0x00 초기화 및 GDDRAM 전체 클리어 전송 */
  ssd1306Clear();
  ssd1306Update();

  return true;
}

void ssd1306Clear(void)
{
  memset(ssd1306_buffer, 0x00, sizeof(ssd1306_buffer));
}

/**
 * @brief  디스플레이 버퍼를 SSD1306 / SH1106 GDDRAM으로 전송
 * @note   Page Addressing Mode (0~7페이지)로 128바이트씩 전송하여
 *         STM32 I2C 255바이트 NBYTES 리로드 오버플로우를 원천 방지하고
 *         SSD1306과 SH1106 1.3"/0.96" OLED 패널 모두 완벽 호환
 */
void ssd1306Update(void)
{
  for (uint8_t page = 0; page < 8; page++)
  {
    uint8_t page_cmd[3] = {
      (uint8_t)(0xB0 + page), /* Set Page Address (B0 ~ B7) */
      0x00,                   /* Set Lower Column Address (0x00) */
      0x10                    /* Set Higher Column Address (0x10) */
    };

    /* 페이지 주소 및 컬럼 시작 위치 설정 커맨드 전송 */
    HAL_I2C_Mem_Write(&hi2c1, ssd1306_i2c_addr, 0x00, 1, page_cmd, 3, 20);

    /* 해당 페이지의 128바이트 그래픽 데이터 전송 */
    HAL_I2C_Mem_Write(&hi2c1, ssd1306_i2c_addr, 0x40, 1,
                      &ssd1306_buffer[page * SSD1306_WIDTH], SSD1306_WIDTH, 50);
  }
}

void ssd1306DrawPixel(int16_t x, int16_t y, uint8_t color)
{
  if (x < 0 || x >= SSD1306_WIDTH || y < 0 || y >= SSD1306_HEIGHT)
    return;

  if (color == SSD1306_COLOR_WHITE)
    ssd1306_buffer[x + (y / 8) * SSD1306_WIDTH] |= (1 << (y % 8));
  else
    ssd1306_buffer[x + (y / 8) * SSD1306_WIDTH] &= ~(1 << (y % 8));
}

void ssd1306DrawLine(int16_t x0, int16_t y0, int16_t x1, int16_t y1, uint8_t color)
{
  int16_t dx = abs(x1 - x0);
  int16_t sx = x0 < x1 ? 1 : -1;
  int16_t dy = -abs(y1 - y0);
  int16_t sy = y0 < y1 ? 1 : -1;
  int16_t err = dx + dy;
  int16_t e2;

  while (1)
  {
    ssd1306DrawPixel(x0, y0, color);
    if (x0 == x1 && y0 == y1)
      break;
    e2 = 2 * err;
    if (e2 >= dy)
    {
      err += dy;
      x0 += sx;
    }
    if (e2 <= dx)
    {
      err += dx;
      y0 += sy;
    }
  }
}

void ssd1306DrawRect(int16_t x, int16_t y, int16_t w, int16_t h, uint8_t color)
{
  ssd1306DrawLine(x, y, x + w - 1, y, color);
  ssd1306DrawLine(x, y + h - 1, x + w - 1, y + h - 1, color);
  ssd1306DrawLine(x, y, x, y + h - 1, color);
  ssd1306DrawLine(x + w - 1, y, x + w - 1, y + h - 1, color);
}

void ssd1306FillRect(int16_t x, int16_t y, int16_t w, int16_t h, uint8_t color)
{
  for (int16_t i = x; i < x + w; i++)
  {
    for (int16_t j = y; j < y + h; j++)
    {
      ssd1306DrawPixel(i, j, color);
    }
  }
}

void ssd1306DrawChar(int16_t x, int16_t y, char ch, uint8_t color)
{
  if (ch < ' ' || ch > '~')
    return;

  uint8_t index = ch - ' ';
  for (uint8_t i = 0; i < 6; i++)
  {
    uint8_t line = font6x8[index][i];
    for (uint8_t j = 0; j < 8; j++)
    {
      if (line & (1 << j))
      {
        ssd1306DrawPixel(x + i, y + j, color);
      }
      else
      {
        ssd1306DrawPixel(x + i, y + j, !color);
      }
    }
  }
}

void ssd1306DrawString(int16_t x, int16_t y, const char *str, uint8_t color)
{
  while (*str)
  {
    ssd1306DrawChar(x, y, *str, color);
    x += 6;
    str++;
  }
}

void ssd1306Test(void)
{
  ssd1306Clear();
  ssd1306DrawRect(0, 0, SSD1306_WIDTH, SSD1306_HEIGHT, SSD1306_COLOR_WHITE);
  ssd1306DrawString(16, 6, "STM32H523", SSD1306_COLOR_WHITE);
  ssd1306DrawLine(10, 18, 118, 18, SSD1306_COLOR_WHITE);
  ssd1306DrawString(8, 24, "OLED: SSD1306", SSD1306_COLOR_WHITE);
  ssd1306DrawString(8, 36, "I2C1: 400kHz", SSD1306_COLOR_WHITE);
  ssd1306DrawString(8, 48, "System OK!", SSD1306_COLOR_WHITE);
  ssd1306Update();
}
